## build/left/Kconfig/Kconfig.modules
```kconfig
menu "zmk-pmw3610-driver (/Users/haroldhernandez/Charybdis/zmk-config-charybdis_nano/zmk-pmw3610-driver)"
osource "/Users/haroldhernandez/Charybdis/zmk-config-charybdis_nano/zmk-pmw3610-driver/Kconfig"
config ZEPHYR_ZMK_PMW3610_DRIVER_MODULE
	bool
	default y
endmenu
menu "nanopb (/Users/haroldhernandez/Charybdis/zmk-config-charybdis_nano/modules/lib/nanopb)"
osource "$(ZEPHYR_NANOPB_KCONFIG)"
config ZEPHYR_NANOPB_MODULE
	bool
	default y
endmenu
menu "acpica (/Users/haroldhernandez/Charybdis/zmk-config-charybdis_nano/modules/lib/acpica)"
osource "$(ZEPHYR_ACPICA_KCONFIG)"
config ZEPHYR_ACPICA_MODULE
	bool
	default y
endmenu
menu "canopennode (/Users/haroldhernandez/Charybdis/zmk-config-charybdis_nano/modules/lib/canopennode)"
osource "$(ZEPHYR_CANOPENNODE_KCONFIG)"
config ZEPHYR_CANOPENNODE_MODULE
	bool
	default y
endmenu
menu "cmsis (/Users/haroldhernandez/Charybdis/zmk-config-charybdis_nano/modules/hal/cmsis)"
osource "$(ZEPHYR_CMSIS_KCONFIG)"
config ZEPHYR_CMSIS_MODULE
	bool
	default y
endmenu
menu "cmsis-dsp (/Users/haroldhernandez/Charybdis/zmk-config-charybdis_nano/modules/lib/cmsis-dsp)"
osource "$(ZEPHYR_CMSIS_DSP_KCONFIG)"
config ZEPHYR_CMSIS_DSP_MODULE
	bool
	default y
endmenu
menu "cmsis-nn (/Users/haroldhernandez/Charybdis/zmk-config-charybdis_nano/modules/lib/cmsis-nn)"
osource "$(ZEPHYR_CMSIS_NN_KCONFIG)"
config ZEPHYR_CMSIS_NN_MODULE
	bool
	default y
endmenu
menu "fatfs (/Users/haroldhernandez/Charybdis/zmk-config-charybdis_nano/modules/fs/fatfs)"
osource "$(ZEPHYR_FATFS_KCONFIG)"
config ZEPHYR_FATFS_MODULE
	bool
	default y
endmenu
menu "hal_ambiq (/Users/haroldhernandez/Charybdis/zmk-config-charybdis_nano/modules/hal/ambiq)"
osource "$(ZEPHYR_HAL_AMBIQ_KCONFIG)"
config ZEPHYR_HAL_AMBIQ_MODULE
	bool
	default y
endmenu
menu "hal_espressif (/Users/haroldhernandez/Charybdis/zmk-config-charybdis_nano/modules/hal/espressif)"
osource "/Users/haroldhernandez/Charybdis/zmk-config-charybdis_nano/modules/hal/espressif/zephyr/Kconfig"
config ZEPHYR_HAL_ESPRESSIF_MODULE
	bool
	default y
endmenu
menu "hal_ethos_u (/Users/haroldhernandez/Charybdis/zmk-config-charybdis_nano/modules/hal/ethos_u)"
osource "$(ZEPHYR_HAL_ETHOS_U_KCONFIG)"
config ZEPHYR_HAL_ETHOS_U_MODULE
	bool
	default y
endmenu
menu "hal_gigadevice (/Users/haroldhernandez/Charybdis/zmk-config-charybdis_nano/modules/hal/gigadevice)"
osource "$(ZEPHYR_HAL_GIGADEVICE_KCONFIG)"
config ZEPHYR_HAL_GIGADEVICE_MODULE
	bool
	default y
endmenu
menu "hal_nordic (/Users/haroldhernandez/Charybdis/zmk-config-charybdis_nano/modules/hal/nordic)"
osource "$(ZEPHYR_HAL_NORDIC_KCONFIG)"
config ZEPHYR_HAL_NORDIC_MODULE
	bool
	default y
endmenu
menu "hal_rpi_pico (/Users/haroldhernandez/Charybdis/zmk-config-charybdis_nano/modules/hal/rpi_pico)"
osource "$(ZEPHYR_HAL_RPI_PICO_KCONFIG)"
config ZEPHYR_HAL_RPI_PICO_MODULE
	bool
	default y
endmenu
menu "hal_telink (/Users/haroldhernandez/Charybdis/zmk-config-charybdis_nano/modules/hal/telink)"
osource "/Users/haroldhernandez/Charybdis/zmk-config-charybdis_nano/modules/hal/telink/Kconfig"
config ZEPHYR_HAL_TELINK_MODULE
	bool
	default y
endmenu
menu "liblc3 (/Users/haroldhernandez/Charybdis/zmk-config-charybdis_nano/modules/lib/liblc3)"
osource "$(ZEPHYR_LIBLC3_KCONFIG)"
config ZEPHYR_LIBLC3_MODULE
	bool
	default y
endmenu
menu "littlefs (/Users/haroldhernandez/Charybdis/zmk-config-charybdis_nano/modules/fs/littlefs)"
osource "$(ZEPHYR_LITTLEFS_KCONFIG)"
config ZEPHYR_LITTLEFS_MODULE
	bool
	default y
endmenu
menu "lvgl (/Users/haroldhernandez/Charybdis/zmk-config-charybdis_nano/modules/lib/gui/lvgl)"
osource "/Users/haroldhernandez/Charybdis/zmk-config-charybdis_nano/modules/lib/gui/lvgl/Kconfig"
config ZEPHYR_LVGL_MODULE
	bool
	default y
endmenu
menu "mbedtls (/Users/haroldhernandez/Charybdis/zmk-config-charybdis_nano/modules/crypto/mbedtls)"
osource "$(ZEPHYR_MBEDTLS_KCONFIG)"
config ZEPHYR_MBEDTLS_MODULE
	bool
	default y
endmenu
menu "percepio (/Users/haroldhernandez/Charybdis/zmk-config-charybdis_nano/modules/debug/percepio)"
osource "/Users/haroldhernandez/Charybdis/zmk-config-charybdis_nano/modules/debug/percepio/zephyr/Kconfig"
config ZEPHYR_PERCEPIO_MODULE
	bool
	default y
endmenu
menu "picolibc (/Users/haroldhernandez/Charybdis/zmk-config-charybdis_nano/modules/lib/picolibc)"
osource "/Users/haroldhernandez/Charybdis/zmk-config-charybdis_nano/modules/lib/picolibc/zephyr/Kconfig"
config ZEPHYR_PICOLIBC_MODULE
	bool
	default y
endmenu
menu "segger (/Users/haroldhernandez/Charybdis/zmk-config-charybdis_nano/modules/debug/segger)"
osource "$(ZEPHYR_SEGGER_KCONFIG)"
config ZEPHYR_SEGGER_MODULE
	bool
	default y
endmenu
menu "trusted-firmware-a (/Users/haroldhernandez/Charybdis/zmk-config-charybdis_nano/modules/tee/tf-a/trusted-firmware-a)"
osource "$(ZEPHYR_TRUSTED_FIRMWARE_A_KCONFIG)"
config ZEPHYR_TRUSTED_FIRMWARE_A_MODULE
	bool
	default y
endmenu
menu "uoscore-uedhoc (/Users/haroldhernandez/Charybdis/zmk-config-charybdis_nano/modules/lib/uoscore-uedhoc)"
osource "$(ZEPHYR_UOSCORE_UEDHOC_KCONFIG)"
config ZEPHYR_UOSCORE_UEDHOC_MODULE
	bool
	default y
endmenu
menu "zcbor (/Users/haroldhernandez/Charybdis/zmk-config-charybdis_nano/modules/lib/zcbor)"
osource "$(ZEPHYR_ZCBOR_KCONFIG)"
config ZEPHYR_ZCBOR_MODULE
	bool
	default y
endmenu
menu "module (/Users/haroldhernandez/Charybdis/zmk-config-charybdis_nano/zmk/app/module)"
osource "/Users/haroldhernandez/Charybdis/zmk-config-charybdis_nano/zmk/app/module/Kconfig"
config ZEPHYR_MODULE_MODULE
	bool
	default y
endmenu
```

## build/left/Kconfig/Kconfig.shield
```kconfig
osource "/Users/haroldhernandez/Charybdis/zmk-config-charybdis_nano/zmk/app/boards/shields/*/Kconfig.shield"
osource "/Users/haroldhernandez/Charybdis/zmk-config-charybdis_nano/config/boards/shields/*/Kconfig.shield"
```

## build/right/Kconfig/Kconfig.shield.defconfig
```kconfig
osource "/Users/haroldhernandez/Charybdis/zmk-config-charybdis_nano/zmk/app/boards/shields/*/Kconfig.defconfig"
osource "/Users/haroldhernandez/Charybdis/zmk-config-charybdis_nano/config/boards/shields/*/Kconfig.defconfig"
```

## config/west.yml
```yaml
manifest:
  remotes:
    - name: harlord
      url-base: https://github.com/harlord      
  projects:
    - name: zmk
      remote: harlord
      revision: main-local2-to-zephyr-4-1
      import: app/west.yml
    # Removed zmk-pmw3610-driver - now using native Zephyr CONFIG_INPUT_PMW3610 driver
  self:
    path: config
```
