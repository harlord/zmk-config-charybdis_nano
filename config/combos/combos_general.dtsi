
/*
 mira los valores de key-positions para actualizarlos acorde a estas reglas, 
 Si alguno de los valores es igual o mayor a 30, se restan 3
*/



        //     0  1  2  3  4             5  6  7  8  9
        //    10 11 12 13 14            15 16 17 18 19
        //    20 21 22 23 24            25 26 27 28 29 
        //          30 31 32            33 34 

        //     0  1  2  3  4             5  6  7  8  9
        //    10 11 12 13 14            15 16 17 18 19
        //    20 21 22 23 24            25 26 27 28 29 
        //    30 31 32 33 34 35      36 37          38



#define THUMB_HOLDING_TIME 220
#define REQUIRE_PRIOR_IDLE_MS 180   

#define LCOMBOACT(NAME, BINDINGS, KEYPOS) \
  LCOMBOACT_##NAME { \
    timeout-ms = <2000>; \
    bindings = <BINDINGS>; \
    key-positions = <KEYPOS>; \
    slow-release; \
    require-prior-idle-ms = <REQUIRE_PRIOR_IDLE_MS>; \
    layers = <BASE NUMBERS FUNC LOWER RAISE>; \
  };

#define COMBOMOUUACT(NAME, BINDINGS, KEYPOS) \
  COMBOMOUUACT_##NAME { \
    timeout-ms = <2000>; \
    bindings = <&kp RGUI>, <BINDINGS>; \
    slow-release; \
    key-positions = <KEYPOS>; \
    layers = <SNIPE SNIPETOP SCROLL FAST MOUSETOP SCROLLTOP>; \
  };

#define COMBOMOUUACTCMD(NAME, BINDINGS, KEYPOS) \
  COMBOMOUUACTCMD_##NAME { \
    timeout-ms = <2000>; \
    bindings = <BINDINGS>; \
    slow-release; \
    key-positions = <KEYPOS>; \
    layers = <SNIPE SNIPETOP SCROLL FAST MOUSETOP SCROLLTOP>; \
  };

#define RCOMBOACT(NAME, BINDINGS, KEYPOS) \
  RCOMBOACT_##NAME { \
    timeout-ms = <2000>; \
    bindings = <BINDINGS>; \
    key-positions = <KEYPOS>; \
    slow-release; \
    require-prior-idle-ms = <REQUIRE_PRIOR_IDLE_MS>; \
    layers = <BASE NUMBERS FUNC LOWER RAISE>; \
  };

#define RCOMBO(NAME, BINDINGS, KEYPOS) \
  rcombo_##NAME { \
    timeout-ms = <500>; \
    bindings = <BINDINGS>; \
    key-positions = <KEYPOS>; \
    require-prior-idle-ms = <REQUIRE_PRIOR_IDLE_MS>; \
    layers = <BASE FUNC LOWER RAISE>; \
  };

#define RCOMBOMOUSE(NAME, BINDINGS, KEYPOS) \
  rcombomouse_##NAME { \
    timeout-ms = <800>; \
    bindings = <BINDINGS>; \
    require-prior-idle-ms = <REQUIRE_PRIOR_IDLE_MS>; \
    key-positions = <KEYPOS>; \
    layers = <SNIPE SNIPETOP SCROLL FAST MOUSETOP SCROLLTOP>; \
  };

#define LSHCOMBO(BINDINGS, KEYPOS) \
  lshcombo_##KEYPOS { \
    timeout-ms = <2000>; \
    bindings = <&mc_cbshift BINDINGS>; \
    key-positions = <KEYPOS 16 17>; \
    slow-release; \
    layers = <BASE>; \
  };

#define RSHCOMBO(BINDINGS, KEYPOS) \
  rshcombo_##KEYPOS { \
    timeout-ms = <2000>; \
    bindings = <&mc_cbshift BINDINGS>; \
    key-positions = <KEYPOS 12 13>; \
    slow-release; \
    layers = <BASE>; \
  };

#define RACOMBO(BINDINGS, KEYPOS) \
  racombo_##KEYPOS { \
    timeout-ms = <THUMB_HOLDING_TIME>; \
    bindings = <&mc_cbraise BINDINGS>; \
    key-positions = <KEYPOS 31 34>; \
    slow-release; \
    layers = <BASE>; \
  };

#define LCOMBO(NAME, BINDINGS, KEYPOS) \
  lcombo_##NAME { \
    timeout-ms = <500>; \
    bindings = <BINDINGS>; \
    key-positions = <KEYPOS>; \
    require-prior-idle-ms = <REQUIRE_PRIOR_IDLE_MS>; \
    layers = <BASE NUMBERS FUNC LOWER RAISE>; \
  };

#define LCOMBOMOUSE(NAME, BINDINGS, KEYPOS) \
  lcombomou_##NAME { \
    timeout-ms = <500>; \
    bindings = <BINDINGS>; \
    key-positions = <KEYPOS>; \
    require-prior-idle-ms = <REQUIRE_PRIOR_IDLE_MS>; \
    layers = <SNIPE SNIPETOP SCROLL FAST MOUSETOP SCROLLTOP>; \
  };

#define COMBOADJ(NAME, BINDINGS, KEYPOS) \
  comboadj_##NAME { \
    timeout-ms = <500>; \
    bindings = <BINDINGS>; \
    key-positions = <KEYPOS>; \
    layers = <ADJ>; \
  }; 

#define COMBOSYSTEM(NAME, BINDINGS, KEYPOS) \
  combosystem_##NAME { \
    timeout-ms = <500>; \
    bindings = <BINDINGS>; \
    key-positions = <KEYPOS>; \
    layers = <SYSTEM>; \
  };

#define CBKS(BINDINGS, KEYPOS) \
  cbks_##KEYPOS { \
    timeout-ms = <2000>; \
    bindings = <BINDINGS>; \
    key-positions = <KEYPOS 31>; \
    key-positions-leader = <KEYPOS>; \
    key-positions-first-exclude = <31>; \
    layers = <BASE RAISE FUNC>; \
  };

#define SHIFTRIGHT(BINDINGS, KEYPOS) \
  shiftright_##KEYPOS { \
    timeout-ms = <2000>; \
    bindings = <BINDINGS>; \
    key-positions = <KEYPOS 20>; \
    key-positions-leader = <KEYPOS>; \
    key-positions-first-exclude = <20>; \
    layers = <BASE RAISE FUNC>; \
  };

#define SHIFTLEFT(BINDINGS, KEYPOS) \
  shiftleft_##KEYPOS { \
    timeout-ms = <2000>; \
    bindings = <BINDINGS>; \
    key-positions = <KEYPOS 29>; \
    key-positions-leader = <KEYPOS>; \
    key-positions-first-exclude = <29>; \
    layers = <BASE RAISE FUNC>; \
  };

#define CBKSHIFT(BINDINGS, KEYPOS) \
  cbkshift_##KEYPOS { \
    timeout-ms = <2000>; \
    bindings = <&mshoff>, <BINDINGS>; \
    key-positions = <KEYPOS 31>; \
    key-positions-leader = <KEYPOS>; \
    key-positions-first-exclude = <31>; \
    slow-release; \
    layers = <BASE RAISE FUNC>; \
  };

    combos {
        compatible = "zmk,combos";
        //THUMB LEFT HAND
        COMBOMOUUACT(comb_t_pb, &kp ESC, 3 4)
        COMBOMOUUACT(comb_t_qwf, &kp CAPS, 0 1 2)
        COMBOMOUUACT(comb_t_wfp, &kp DELETE, 1 2 3)
        COMBOMOUUACT(comb_t_pg, &kp BACKSPACE, 3 14)
        COMBOMOUUACTCMD(comb_t_dv, &mc_kp_cmd TAB, 23 24)

        //LEFT HAND
        LCOMBOACT(comb_pb, &kp ESC, 3 4)
        LCOMBOACT(comb_qwf, &kp CAPS, 0 1 2)
        LCOMBOACT(comb_wfp, &kp DELETE, 1 2 3)
        LCOMBOACT(comb_pg, &kp BACKSPACE, 3 14)
        LCOMBOACT(comb_dv, &kp TAB, 23 24)

        LCOMBO(comb_gv, &kp MINUS, 14 24)// G V
        LCOMBO(comb_td, &kp GRAVE, 13 23)// T D 
        LCOMBO(comb_sc, &kp RBKT, 12 22)// S C
        LCOMBO(comb_rx, &kp LBKT, 11 21)// R X
        LCOMBO(comb_az, &kp BSLH, 10 20)// A Z

        //THUMB RIGHT HAND (commented because the mouse + navigation changes)
        COMBOMOUUACT(comb_t_jl, &kp ESC, 5 6)
        //COMBOMOUUACT(comb_t_uysqt, &caps_word, 7 8 9)
        COMBOMOUUACT(comb_t_lm, &kp SPACE, 6 15)
        COMBOMOUUACT(comb_t_kh, &kp ENTER, 25 26)

        //RIGHT HAND
        RCOMBOACT(comb_jl, &kp ESC,  5 6)
        RCOMBOACT(comb_luy, &kp GLOBE, 6 7 8)
        RCOMBOACT(comb_uysqt, &caps_word, 7 8 9)
        RCOMBOACT(comb_lm, &kp SPACE, 6 15)
        RCOMBOACT(comb_kh, &kp ENTER, 25 26)

        RCOMBOMOUSE(requal_mou, &kp EQUAL, 15 25)
        RCOMBO(requal, &kp EQUAL, 15 25)
        RCOMBO(rsemi, &kp SEMI, 16 26)
        RCOMBO(SEMI, &kp COMMA, 17 27)
        RCOMBO(COLON, &kp DOT, 18 28)
        RCOMBO(FSLH, &kp FSLH, 19 29)

        //NUMBERS
        //LCOMBOMOUSE(NUMMO5, &kp N5, 4 14)
        LCOMBO(NUM1, &kp N1, 0 10)
        LCOMBO(NUM2, &kp N2, 1 11)
        LCOMBO(NUM3, &kp N3, 2 12)
        LCOMBO(NUM4, &kp N4, 3 13)
        LCOMBO(NUM5, &kp N5, 4 14)
        RCOMBO(NUM6, &kp N6, 5 15)
        RCOMBO(NUM7, &kp N7, 6 16)
        RCOMBO(NUM8, &kp N8, 7 17) 
        RCOMBO(NUM9, &kp N9, 8 18)
        RCOMBO(NUM0, &kp N0, 9 19)

        // ADJUST 
        COMBOSYSTEM(adj_tog_on, &tog_on ADJ,  0  1  2  3 )
        COMBOADJ(adj_tog_off, &tog_off ADJ,  0  1  2  3 )

        //THUMB
        combo_system_thumb_l: combo_system_thumb_l {
            bindings = <&kp GRAVE>;   // or your desired behavior
            key-positions = <31 32>;     // the key you press
            timeout-ms = <300>;       // regular combo timeout
            slow-release;
            //layers = <BASE>;
        };

        combo_system_thumb_r: combo_system_thumb_r {
            bindings = <&mo SYSTEM>;   // or your desired behavior
            key-positions = <33 34>;     // the key you press
            timeout-ms = <300>;       // regular combo timeout
            slow-release;
            layers = <BASE>;
        };



//When SNIPETOP/tab thump is pressed, this should to wait the timer to activate the layer
//so if the pointer is moving, the slow pointer is not notice until the layer is activated.
//This combo force a inmediate activation if thumb is presed and pointer move is detected 
         combo_mouse_thumb: combo_mouse_thumb {
            bindings = <&mo SNIPETOP>;   // or your desired behavior
            key-positions = <31>;     // the key you press
            timeout-ms = <1000>;       // regular combo timeout
            require-pointer-move;     // gate on movement
            pointer-move-timeout-ms = <500>; // optional; else uses timeout-ms
            layers = <BASE>;          // where it applies
        };

        //EDIT POINTER
        combo_t_cut: combo_t_cut {
            bindings = <&kp RG(X)>;   // or your desired behavior
            key-positions = <21>;     // the key you press
            timeout-ms = <1000>;       // regular combo timeout
            require-pointer-move;     // gate on movement
            pointer-move-timeout-ms = <500>; // optional; else uses timeout-ms
            layers = < SNIPE SNIPETOP SCROLL FAST MOUSETOP SCROLLTOP>;          // where it applies
        };

        combo_t_copy: combo_t_copy {
            bindings = <&mc_two_tap RG(C)>;   // or your desired behavior
            key-positions = <22>;     // the key you press
            timeout-ms = <1000>;       // regular combo timeout
            require-pointer-move;     // gate on movement
            pointer-move-timeout-ms = <500>; // optional; else uses timeout-ms
            layers = < SNIPE SNIPETOP SCROLL FAST MOUSETOP SCROLLTOP>;          // where it applies
        };

        combo_t_paste: combo_t_paste {
            bindings = <&kp RG(V)>;   // or your desired behavior
            key-positions = <23>;     // the key you press
            timeout-ms = <1000>;       // regular combo timeout
            require-pointer-move;     // gate on movement
            pointer-move-timeout-ms = <500>; // optional; else uses timeout-ms
            layers = <SNIPE SNIPETOP SCROLL FAST MOUSETOP SCROLLTOP>;          // where it applies
        };

        // combo_t_save: combo_t_save {
        //     bindings = <&kp RG(S)>;
        //     key-positions = <12>;
        //     timeout-ms = <1000>;
        //     require-pointer-move;
        //     pointer-move-timeout-ms = <500>;
        //     layers = <SNIPE SNIPETOP SCROLL FAST MOUSETOP>;
        // };


        // LEFT MOUSE

        combo_scroll_lh_up: combo_scroll_lh_up {
            bindings = <&mo SCROLLTOP>;   // or your desired behavior
            key-positions = <11>;     // the key you press
            timeout-ms = <1000>;       // regular combo timeout
            require-pointer-move;     // gate on movement
            pointer-move-timeout-ms = <500>; // optional; else uses timeout-ms
            layers = <BASE RAISE NUMBERS LOWER FUNC>;          // where it applies
        };

        combo_mouse_lh_l: combo_mouse_lh_l {
            bindings = <&mcmou LCLK>;   // or your desired behavior
            key-positions = <13>;     // the key you press
            timeout-ms = <1000>;       // regular combo timeout
            require-pointer-move;     // gate on movement
            pointer-move-timeout-ms = <500>; // optional; else uses timeout-ms
            layers = <BASE RAISE NUMBERS LOWER FUNC>;          // where it applies
        };


//shift+BKSPACE<>TILDE 
CBKSHIFT(&mshon LA(N1), 0)                                                                                                                                                                                                                                   CBKS(&mc_bkctilde U, 7) 
CBKS(&mc_bkctilde A, 10)                                                                                                                                                                                                             CBKS(&mc_ennesd N, 16)  CBKS(&mc_bkctilde E, 17)  CBKS(&mc_bkctilde I, 18)  CBKS(&mc_bkctilde O, 19)
                                                                                                                                                                                                                                                                                                                 CBKS(&mc_quesd, 29)


//this is for enure to get the "?"
SHIFTLEFT(&kp LS(SLASH), 20) 

//this is for enure to get the "Z"
SHIFTRIGHT(&kp LS(Z), 29) 




LSHCOMBO(Q, 0) LSHCOMBO(W, 1) LSHCOMBO(F, 2) LSHCOMBO(P, 3) LSHCOMBO(B, 4)
LSHCOMBO(A, 10) LSHCOMBO(R, 11) LSHCOMBO(S, 12) LSHCOMBO(T, 13) LSHCOMBO(G, 14) 
LSHCOMBO(Z, 20) LSHCOMBO(X, 21) LSHCOMBO(C, 22) LSHCOMBO(D, 23) LSHCOMBO(V, 24)

RSHCOMBO(J, 5) RSHCOMBO(L, 6) RSHCOMBO(U, 7) RSHCOMBO(Y, 8) RSHCOMBO(SQT, 9)
RSHCOMBO(M, 15) RSHCOMBO(N, 16) RSHCOMBO(E, 17) RSHCOMBO(I, 18) RSHCOMBO(O, 19)
RSHCOMBO(K, 25) RSHCOMBO(H, 26) RSHCOMBO(COMMA, 27) RSHCOMBO(DOT, 28) RSHCOMBO(SLASH, 29)

/*
  1  2  3  4    
10 11 12 13 14    
20 21 22 23 24    
30 31 32     


5  6  7  8  9
15 16 17 18 19
25 26 27 28 29 
33 34 
*/

RACOMBO(EXCL, 0)   RACOMBO(AT, 1)     RACOMBO(HASH, 2)   RACOMBO(DLLR, 3)    RACOMBO(PRCNT, 4)            RACOMBO(CARET, 5)   RACOMBO(AMPS, 6)    RACOMBO(STAR, 7)    RACOMBO(LPAR, 8)  RACOMBO(RPAR, 9)
RACOMBO(PIPE, 10)  RACOMBO(LBRC, 11)  RACOMBO(RBRC, 12)  RACOMBO(TILDE, 13)  RACOMBO(UNDER, 14)           RACOMBO(PLUS, 15)   RACOMBO(COLON, 16)  RACOMBO(LT, 17)     RACOMBO(GT, 18)   RACOMBO(QUESTION, 19)
RACOMBO(BSLH, 20)  RACOMBO(LBKT, 21)  RACOMBO(RBKT, 22)  RACOMBO(GRAVE, 23)  RACOMBO(MINUS, 24)           RACOMBO(EQUAL, 25)  RACOMBO(SEMI, 26)   RACOMBO(COMMA, 27)  RACOMBO(DOT, 28)  RACOMBO(SLASH, 29)

};