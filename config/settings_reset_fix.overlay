#include <dt-bindings/zmk/matrix_transform.h>

/ {
    chosen {
        zmk,matrix_transform = &settings_reset_transform;
    };

    settings_reset_transform: settings_reset_transform {
        compatible = "zmk,matrix-transform";
        columns = <1>;
        rows = <1>;
        map = <RC(0,0)>;
    };
};

&settings_reset_kscan {
    rows = <1>;
};
