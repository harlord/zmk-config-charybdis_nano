// Settings tuned for 3840 x 2160 display resolution

#include <dt-bindings/zmk/pointing.h>
#include <input/processors.dtsi>
#include <zephyr/dt-bindings/input/input-event-codes.h>
// Keyboard mouse emulation behaviors (not used - trackball handles pointing)
// Keep this file for pointing.h include and de